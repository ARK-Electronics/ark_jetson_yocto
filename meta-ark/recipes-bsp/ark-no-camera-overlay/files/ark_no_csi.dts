// SPDX-License-Identifier: MIT
// Copyright (c) 2026 ARK Electronics.

/dts-v1/;
/plugin/;

/ {
    overlay-name = "ARK JAJ camera-less bench";
    compatible = "ark,jaj-p3767-0000-super", "nvidia,p3768-0000+p3767-0000-super";

    fragment@0 {
        target-path = "/";
        board_config {
            sw-modules = "kernel";
        };
        __overlay__ {
            bus@0 {
                // Firmware-media camera overlays are applied before extlinux
                // OVERLAYS. Disable enumeration only after that earlier merge.
                // A root target also permits a clean DTB without this mux.
                cam_i2cmux {
                    status = "disabled";
                };
            };
        };
    };
};
