// SPDX-License-Identifier: GPL-2.0-only
// Copyright (c) 2026 ARK Electronics.

#include "tegra234-p3768-0000+p3767-0000-nv-super.dts"
#include "ark-JAJ-overrides.dtsi"

/ {
    model = "NVIDIA Jetson Orin NX 16GB ARK JAJ Jetson Carrier Super";
    compatible = "ark,jaj-p3767-0000-super", "nvidia,p3768-0000+p3767-0000-super", "nvidia,p3767-0000", "nvidia,tegra234";
};
