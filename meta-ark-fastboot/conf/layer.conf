## meta-ark/conf/distro/ark-headless.conf
```bitbake
DISTRO = "ark-headless"
DISTRO_NAME = "ARK Electronics Headless Jetson Linux"
DISTRO_VERSION = "0.1"
DISTRO_CODENAME = "wrynose"
MAINTAINER = "ARK Electronics"
TARGET_VENDOR = "-ark"
PACKAGE_CLASSES = "package_ipk"
INIT_MANAGER = "systemd"
DISTRO_FEATURES = "acl ext2 ipv4 ipv6 largefile pam pci seccomp systemd usrmerge usbhost wifi xattr"
VIRTUAL-RUNTIME_init_manager = "systemd"
VIRTUAL-RUNTIME_initscripts = ""
PREFERRED_PROVIDER_virtual/kernel = "linux-noble-nvidia-tegra"
USE_REDUNDANT_FLASH_LAYOUT_DEFAULT = "0"
IMAGE_LINGUAS = "en-us"
GLIBC_GENERATE_LOCALES = "en_US.UTF-8"
SDK_VENDOR = "-arksdk"
SDK_VERSION = "${DISTRO_VERSION}"
```

## meta-ark/conf/layer.conf
```bitbake
BBPATH .= ":${LAYERDIR}"
BBFILES += "${LAYERDIR}/recipes-*/*/*.bb ${LAYERDIR}/recipes-*/*/*.bbappend"
BBFILE_COLLECTIONS += "ark"
BBFILE_PATTERN_ark = "^${LAYERDIR}/"
BBFILE_PRIORITY_ark = "10"
LAYERVERSION_ark = "1"
LAYERDEPENDS_ark = "core tegra openembedded-layer"
LAYERSERIES_COMPAT_ark = "wrynose"
```
